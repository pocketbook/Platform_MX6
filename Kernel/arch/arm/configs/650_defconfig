## Kernel/arch/arm/plat-mxc/devices/Kconfig
```kconfig
menuconfig FREESCALE_PLATFORM_SUPPORT
    tristate "freescale platform support"
    default y

if FREESCALE_PLATFORM_SUPPORT

config IMX_HAVE_PLATFORM_DMA
	bool "platform suport DMA"

config IMX_HAVE_PLATFORM_MXC_MLB
	bool "platform mxc suport  MLB"

config IMX_HAVE_PLATFORM_FEC
	bool "platform suport  FEC"
	default y if ARCH_MX25 || SOC_IMX27 || SOC_IMX35 || SOC_IMX51 || SOC_IMX53

config IMX_HAVE_PLATFORM_FLEXCAN
	select HAVE_CAN_FLEXCAN if CAN
	bool "platform suport FLEXCAN"

config IMX_HAVE_PLATFORM_FSL_USB2_UDC
	bool "platform suport USB2 UDC"

config IMX_HAVE_PLATFORM_GPIO_KEYS
	bool "platform suport GPIO Keys"
	default y if SOC_IMX51

config IMX_HAVE_PLATFORM_GPMI_NFC
	bool "platform suport GPMI NFC"

config IMX_HAVE_PLATFORM_IMX21_HCD
	bool "platform suport IMX21 HCD"

config IMX_HAVE_PLATFORM_IMX2_WDT
	bool "platform suport IMX2 WDT"

config IMX_HAVE_PLATFORM_IMXDI_RTC
	bool "platform support IMXDI RTC"

config IMX_HAVE_PLATFORM_IMX_SRTC
	bool "platform suport IMX SRTC"

config IMX_HAVE_PLATFORM_IMX_SNVS_RTC
	bool "platform suport SNVS RTC"

config IMX_HAVE_PLATFORM_IMX_CAAM
	bool "platform suport IMX CAAM"
	default y if SOC_IMX6Q

config IMX_HAVE_PLATFORM_IMX_FB
	bool "platform suport IMX FB"
	select HAVE_FB_IMX

config IMX_HAVE_PLATFORM_IMX_I2C
	bool "platform suport IMX I2C"

config IMX_HAVE_PLATFORM_IMX_KEYPAD
	bool "platform suport IMX keypad"

config IMX_HAVE_PLATFORM_IMX_SSI
	bool "platform suport IMX SSI"

config IMX_HAVE_PLATFORM_IMX_ESAI
	bool "platform suport IMX esai"

config IMX_HAVE_PLATFORM_IMX_UART
	bool "platform suport IMX uart"

config IMX_HAVE_PLATFORM_IMX_UDC
	bool "platform suport IMX UDC"

config IMX_HAVE_PLATFORM_IPU_CORE
	bool "platform suport IPU core"

config IMX_HAVE_PLATFORM_MX1_CAMERA
	bool "platform suport MX1 camera"

config IMX_HAVE_PLATFORM_MX2_CAMERA
	bool "platform suport MX2 camera"

config IMX_HAVE_PLATFORM_MXC_EHCI
	bool "platform suport MXC ehci"

config IMX_HAVE_PLATFORM_MXC_MMC
	bool "platform suport MXC mmc"

config IMX_HAVE_PLATFORM_MXC_NAND
	bool "platform suport MXC nand"

config IMX_HAVE_PLATFORM_MXC_PWM
	bool "platform suport MXC pwm"

config IMX_HAVE_PLATFORM_MXC_RNGA
	bool "platform suport MXC rnga"
	select ARCH_HAS_RNGA

config IMX_HAVE_PLATFORM_MXC_RTC
	bool "platform suport MXC RTC"

config IMX_HAVE_PLATFORM_MXC_W1
	bool "platform suport MXC W1"

config IMX_HAVE_PLATFORM_SDHCI_ESDHC_IMX
	bool "platform suport SDHCI ESDHC IMX"

config IMX_HAVE_PLATFORM_SPI_IMX
	bool "platform suport IMX SPI"

config IMX_HAVE_PLATFORM_IMX_IPUV3
	bool "platform suport IMX IPUV3"

config IMX_HAVE_PLATFORM_IMX_TVE
	bool "platform suport IMX TVE"

config IMX_HAVE_PLATFORM_IMX_VPU
	bool "platform suport  IMX VPU"

config IMX_HAVE_PLATFORM_IMX_DVFS
	bool "platform suport IMX DVFS"

config IMX_HAVE_PLATFORM_AHCI
	bool "platform suport AHCI"

config IMX_HAVE_PLATFORM_IMX_IIM
	bool "platform suport IMX IIM"

config IMX_HAVE_PLATFORM_MXC_GPU
	bool "platform suport MXC GPU"
	
config IMX_HAVE_PLATFORM_IMX_OCOTP
	bool "platform suport IMX OCOTP "

config IMX_HAVE_PLATFORM_IMX_VIIM
	bool "platform suport IMX VIIM"

config IMX_HAVE_PLATFORM_IMX_DCP
	bool "platform suport IMX DCP"

config IMX_HAVE_PLATFORM_RANDOM_RNGC
	bool "platform suport Random Rngc"

config IMX_HAVE_PLATFORM_PERFMON
	bool "platform suport Perfmon"

config IMX_HAVE_PLATFORM_LDB
	bool "platform suport LDB"

config IMX_HAVE_PLATFORM_IMX_PXP
	bool "platform suport IMX PXP"

config IMX_HAVE_PLATFORM_IMX_ELCDIF
	bool "platform suport IMX Elcdif"

config IMX_HAVE_PLATFORM_IMX_EPDC
	bool "platform suport IMX Epdc"

config IMX_HAVE_PLATFORM_IMX_SPDC
	bool "platform suport IMX Spdc"

config IMX_HAVE_PLATFORM_IMX_SPDIF
	bool "platform suport IMX Spdif"

config IMX_HAVE_PLATFORM_VIV_GPU
    bool "platform suport VIV GPU"

config IMX_HAVE_PLATFORM_MXC_HDMI
	bool "platform suport MXC Hdmi"

config IMX_HAVE_PLATFORM_IMX_ANATOP_THERMAL
	bool "platform suport IMX Anatop thermal"

config IMX_HAVE_PLATFORM_FSL_OTG
	bool "platform suport FSL otg"

config IMX_HAVE_PLATFORM_FSL_USB_WAKEUP
	bool "platform suport  FSL usb wakeup"

config IMX_HAVE_PLATFORM_IMX_PM
	bool "platform suport IMX PM"

config IMX_HAVE_PLATFORM_IMX_ASRC
	bool "platform suport IMX Asrc"

config IMX_HAVE_PLATFORM_IMX_MIPI_DSI
	bool "platform suport IMX mipi dsi"

config IMX_HAVE_PLATFORM_IMX_MIPI_CSI2
	bool "platform suport IMX mipi csi2"

config IMX_HAVE_PLATFORM_IMX_VDOA
	bool "platform suport IMX VDOA"

config IMX_HAVE_PLATFORM_IMX_PCIE
	bool "platform suport IMX Pcie"

config IMX_HAVE_PLATFORM_IMX_FSL_CSI
	bool "platform imx fsl csi support"

endif
```

## Kernel/drivers/media/common/Kconfig
```kconfig
config VIDEO_SAA7146
	tristate "video SAA7146"
	depends on I2C && PCI

config VIDEO_SAA7146_VV
	tristate "video SAA7146 VV"
	depends on VIDEO_V4L2
	select VIDEOBUF_DMA_SG
	select VIDEO_SAA7146
```

## Kernel/drivers/net/wireless/rtl8188EUS_rtl8189ES_linux_v4.1.6_7546.20130521/Kconfig
```kconfig
config RTL8188EU
	select WIRELESS_EXT
	select WEXT_SPY
	select WEXT_PRIV
	tristate "Realtek 8188E USB WiFi"
	depends on USB
	---help---
	  Help message of RTL8188EU
```

## Kernel/drivers/xrz_io/Kconfig
```kconfig
# drivers/xrz_io/Kconfig


menu "XRZtech  support drivers"

config XRZ_IO
	tristate "xrz io Driver"
	default y



endmenu
```

## Kernel/sound/soc/codecs/Kconfig
```kconfig
# Helper to resolve issues with configs that have SPI enabled but I2C
# modular, meaning we can't build the codec driver in with I2C support.
# We use an ordered list of conditional defaults to pick the appropriate
# setting - SPI can't be modular so that case doesn't need to be covered.
config SND_SOC_I2C_AND_SPI
	tristate
	default m if I2C=m
	default y if I2C=y
	default y if SPI_MASTER=y

config SND_SOC_ALL_CODECS
	tristate "Build all ASoC CODEC drivers"
	select SND_SOC_88PM860X if MFD_88PM860X
	select SND_SOC_L3
	select SND_SOC_AC97_CODEC if SND_SOC_AC97_BUS
	select SND_SOC_AD1836 if SPI_MASTER
	select SND_SOC_AD193X if SND_SOC_I2C_AND_SPI
	select SND_SOC_AD1980 if SND_SOC_AC97_BUS
	select SND_SOC_AD73311
	select SND_SOC_ADS117X
	select SND_SOC_AK4104 if SPI_MASTER
	select SND_SOC_AK4535 if I2C
	select SND_SOC_AK4641 if I2C
	select SND_SOC_AK4642 if I2C
	select SND_SOC_AK4671 if I2C
	select SND_SOC_ALC5623 if I2C
	select SND_SOC_CQ0093VC if MFD_DAVINCI_VOICECODEC
	select SND_SOC_CS42L51 if I2C
	select SND_SOC_CS4270 if I2C
	select SND_SOC_CS4271 if SND_SOC_I2C_AND_SPI
	select SND_SOC_CX20442
	select SND_SOC_DA7210 if I2C
	select SND_SOC_DFBMCS320
	select SND_SOC_JZ4740_CODEC if SOC_JZ4740
	select SND_SOC_LM4857 if I2C
	select SND_SOC_CS42888 if I2C
	select SND_SOC_MAX98088 if I2C
	select SND_SOC_MAX98095 if I2C
	select SND_SOC_MAX9850 if I2C
	select SND_SOC_MAX9877 if I2C
	select SND_SOC_PCM3008
	select SND_SOC_SGTL5000 if I2C
	select SND_SOC_SN95031 if INTEL_SCU_IPC
	select SND_SOC_SPDIF
	select SND_SOC_SSM2602 if SND_SOC_I2C_AND_SPI
	select SND_SOC_STAC9766 if SND_SOC_AC97_BUS
	select SND_SOC_TLV320AIC23 if I2C
	select SND_SOC_TLV320AIC26 if SPI_MASTER
	select SND_SOC_TVL320AIC32X4 if I2C
	select SND_SOC_TLV320AIC3X if I2C
	select SND_SOC_TPA6130A2 if I2C
	select SND_SOC_TLV320DAC33 if I2C
	select SND_SOC_TWL4030 if TWL4030_CORE
	select SND_SOC_TWL6040 if TWL4030_CORE
	select SND_SOC_UDA134X
	select SND_SOC_UDA1380 if I2C
	select SND_SOC_WL1273 if MFD_WL1273_CORE
	select SND_SOC_WM1250_EV1 if I2C
	select SND_SOC_WM2000 if I2C
	select SND_SOC_WM8350 if MFD_WM8350
	select SND_SOC_WM8400 if MFD_WM8400
	select SND_SOC_WM8510 if SND_SOC_I2C_AND_SPI
	select SND_SOC_WM8523 if I2C
	select SND_SOC_WM8580 if I2C
	select SND_SOC_WM8711 if SND_SOC_I2C_AND_SPI
	select SND_SOC_WM8727
	select SND_SOC_WM8728 if SND_SOC_I2C_AND_SPI
	select SND_SOC_WM8731 if SND_SOC_I2C_AND_SPI
	select SND_SOC_WM8737 if SND_SOC_I2C_AND_SPI
	select SND_SOC_WM8741 if SND_SOC_I2C_AND_SPI
	select SND_SOC_WM8750 if SND_SOC_I2C_AND_SPI
	select SND_SOC_WM8753 if SND_SOC_I2C_AND_SPI
	select SND_SOC_WM8770 if SPI_MASTER
	select SND_SOC_WM8776 if SND_SOC_I2C_AND_SPI
	select SND_SOC_WM8804 if SND_SOC_I2C_AND_SPI
	select SND_SOC_WM8900 if I2C
	select SND_SOC_WM8903 if I2C
	select SND_SOC_WM8904 if I2C
	select SND_SOC_WM8915 if I2C
	select SND_SOC_WM8940 if I2C
	select SND_SOC_WM8955 if I2C
	select SND_SOC_WM8960 if I2C
	select SND_SOC_WM8961 if I2C
	select SND_SOC_WM8962 if I2C
	select SND_SOC_WM8971 if I2C
	select SND_SOC_WM8974 if I2C
	select SND_SOC_WM8978 if I2C
	select SND_SOC_WM8985 if SND_SOC_I2C_AND_SPI
	select SND_SOC_WM8988 if SND_SOC_I2C_AND_SPI
	select SND_SOC_WM8990 if I2C
	select SND_SOC_WM8991 if I2C
	select SND_SOC_WM8993 if I2C
	select SND_SOC_WM8994 if MFD_WM8994
	select SND_SOC_WM8995 if SND_SOC_I2C_AND_SPI
	select SND_SOC_WM9081 if I2C
	select SND_SOC_WM9090 if I2C
	select SND_SOC_WM9705 if SND_SOC_AC97_BUS
	select SND_SOC_WM9712 if SND_SOC_AC97_BUS
	select SND_SOC_WM9713 if SND_SOC_AC97_BUS
        help
          Normally ASoC codec drivers are only built if a machine driver which
          uses them is also built since they are only usable with a machine
          driver.  Selecting this option will allow these drivers to be built
          without an explicit machine driver for test and development purposes.

	  Support for the bus types used to access the codecs to be built must
	  be selected separately.

          If unsure select "N".

config SND_SOC_88PM860X
	tristate

config SND_SOC_WM_HUBS
	tristate
	default y if SND_SOC_WM8993=y || SND_SOC_WM8994=y
	default m if SND_SOC_WM8993=m || SND_SOC_WM8994=m

config SND_SOC_AC97_CODEC
	tristate
	select SND_AC97_CODEC

config SND_SOC_AD1836
	tristate

config SND_SOC_AD193X
	tristate

config SND_SOC_AD1980
	tristate

config SND_SOC_AD73311
	tristate
	
config SND_SOC_ADS117X
	tristate

config SND_SOC_AK4104
	tristate

config SND_SOC_AK4535
	tristate

config SND_SOC_AK4641
	tristate

config SND_SOC_AK4642
	tristate

config SND_SOC_AK4671
	tristate

config SND_SOC_ALC5623
       tristate

config SND_SOC_CQ0093VC
	tristate

config SND_SOC_CS42L51
	tristate

# Cirrus Logic CS4270 Codec
config SND_SOC_CS4270
	tristate

# Cirrus Logic CS4270 Codec VD = 3.3V Errata
# Select if you are affected by the errata where the part will not function
# if MCLK divide-by-1.5 is selected and VD is set to 3.3V.  The driver will
# not select any sample rates that require MCLK to be divided by 1.5.
config SND_SOC_CS4270_VD33_ERRATA
	bool "cs4270 vd33 errata"
	depends on SND_SOC_CS4270

config SND_SOC_CS4271
	tristate "cs4271"

config SND_SOC_CX20442
	tristate "cx20442"

config SND_SOC_JZ4740_CODEC
	tristate "jz4740 codec"

config SND_SOC_L3
       tristate "L3"

config SND_SOC_DA7210
        tristate "DA7210"

config SND_SOC_DFBMCS320
	tristate "DFBMCS320"

config SND_SOC_DMIC
	tristate "DMIC"

config SND_SOC_MAX98088
       tristate "MAX98088"

config SND_SOC_MAX98095
       tristate "MAX98095"

config SND_SOC_MAX9850
	tristate "MAX9850"

config SND_SOC_MXC_HDMI
       tristate "MXC HDMI"

config SND_SOC_MXC_SPDIF
       tristate "MXC SPDIF"

config SND_SOC_PCM3008
       tristate "PCM3008"

#Freescale sgtl5000 codec
config SND_SOC_SGTL5000
	tristate "SGTL5000"

config SND_SOC_SN95031
	tristate "SN95031"

#CLI CS42888 codec
config SND_SOC_CS42888
	tristate "CS42888"

config SND_SOC_SI4763
        tristate "SI4763"

config SND_SOC_SPDIF
	tristate "SPDIF"

config SND_SOC_SSM2602
	tristate "SSM2602"

config SND_SOC_STAC9766
	tristate "STAC9766"

config SND_SOC_TLV320AIC23
	tristate "TLV320AIC23"

config SND_SOC_AIC325X
	tristate "AIC325x Audio Codec"
	default n
	
config SND_SOC_TLV320AIC26
	tristate "TI TLV320AIC26 Codec support" if SND_SOC_OF_SIMPLE
	depends on SPI

config SND_SOC_TVL320AIC32X4
	tristate "TVL320AIC32X4"

config SND_SOC_TLV320AIC3X
	tristate "TLV320AIC3X"

config SND_SOC_TLV320DAC33
	tristate "TLV320DAC33"

config SND_SOC_TWL4030
	select TWL4030_CODEC
	tristate "TWL4030"

config SND_SOC_TWL6040
	tristate "TWL6040"

config SND_SOC_UDA134X
       tristate "UDA134X"

config SND_SOC_UDA1380
        tristate "UDA1380"

config SND_SOC_WL1273
	tristate "WL1273"

config SND_SOC_WM1250_EV1
	tristate "WM1250 EV1"

config SND_SOC_WM8350
	tristate "WM8350"

config SND_SOC_WM8400
	tristate "WM8400"

config SND_SOC_WM8510
	tristate "WM8510"

config SND_SOC_WM8523
	tristate "WM8580"

config SND_SOC_WM8580
	tristate

config SND_SOC_WM8711
	tristate "WM8711"

config SND_SOC_WM8727
	tristate "WM8727"

config SND_SOC_WM8728
	tristate "WM8728"

config SND_SOC_WM8731
	tristate "WM8731"

config SND_SOC_WM8737
	tristate "WM8737"

config SND_SOC_WM8741
	tristate "WM8741"

config SND_SOC_WM8750
	tristate "WM8750"

config SND_SOC_WM8753
	tristate "WM8753"

config SND_SOC_WM8770
	tristate "WM8770"

config SND_SOC_WM8776
	tristate "WM8776"

config SND_SOC_WM8804
	tristate "WM8804"

config SND_SOC_WM8900
	tristate "WM8900"

config SND_SOC_WM8903
	tristate "WM8903"

config SND_SOC_WM8904
	tristate "WM8904"

config SND_SOC_WM8915
	tristate "WM8915"

config SND_SOC_WM8940
        tristate "WM8940"

config SND_SOC_WM8955
	tristate "WM8955"

config SND_SOC_WM8960
	tristate "WM8960"

config SND_SOC_WM8961
	tristate "WM8961"

config SND_SOC_WM8962
	tristate "WM8962"

config SND_SOC_WM8971
	tristate "WM8971"

config SND_SOC_WM8974
	tristate "WM8974"

config SND_SOC_WM8978
	tristate "WM8978"

config SND_SOC_WM8985
	tristate "wm8985"

config SND_SOC_WM8988
	tristate "wm8988"

config SND_SOC_WM8990
	tristate "wm8990"

config SND_SOC_WM8991
	tristate "wm8991"

config SND_SOC_WM8993
	tristate "wm8993"

config SND_SOC_WM8994
	tristate "wm8994"

config SND_SOC_WM8995
	tristate "wm8995"

config SND_SOC_WM9081
	tristate "wm9081"

config SND_SOC_WM9705
	tristate "wm9705" 

config SND_SOC_WM9712
	tristate "wm9712"

config SND_SOC_WM9713
	tristate  "wm9713"

# Amp
config SND_SOC_LM4857
	tristate "lm4857"

config SND_SOC_MAX9877
	tristate "max9877"

config SND_SOC_TPA6130A2
	tristate "tpa6130a2"

config SND_SOC_WM2000
	tristate "wm2000"

config SND_SOC_WM9090
	tristate "wm9090"
```
